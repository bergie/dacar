/*
 * Dacar C++ port — rfed client library tests (§11.1/§11.1.1, work doc #16
 * Phase 4b).
 *
 * The rfed tree is the spin-out candidate (mirrors the Python `rfed` package),
 * so this suite deliberately does NOT include Dacar.h — only the standalone
 * rfed headers. Every byte-exact expectation (channel derivation, delivery
 * hashes, the HKDF stamp workblock, stamp values, wrapped payloads) is
 * generated by the canonical Python implementation.
 *
 * Licensed under the EUPL-1.2 (see repository root).
 */

#include <unity.h>

#include "rfed/Blob.h"
#include "rfed/Channel.h"
#include "rfed/Client.h"
#include "rfed/Constants.h"
#include "rfed/Stamp.h"

#include "fixtures/FixturesGen.h"

#include <MsgPack.h>

#include <stdexcept>
#include <string>

// The spin-out-purity version of TestUtil.h's exception assertion: this suite
// includes only the standalone rfed headers, not Dacar.h / TestUtil.h.
#ifndef TEST_ASSERT_THROW
#define TEST_ASSERT_THROW(expr, exc_type) \
	do { \
		bool rfed_threw_ = false; \
		try { (void)(expr); } \
		catch (const exc_type&) { rfed_threw_ = true; } \
		catch (...) {} \
		TEST_ASSERT_TRUE(rfed_threw_); \
	} while (0)
#endif

using namespace RFed;

void setUp(void) {}
void tearDown(void) {}

static RNS::Bytes fromHex(const char* hex) {
	RNS::Bytes b;
	if (hex && hex[0]) {
		b.assignHex(hex);
	}
	return b;
}

// -- channel derivation (§1) ----------------------------------------------------

void testChannelDerivationMatchesCanonical() {
	for (size_t i = 0; i < DacarFixtures::RFED_CHANNEL_CASE_COUNT; i++) {
		const auto& c = DacarFixtures::RFED_CHANNEL_CASES[i];
		const Channel channel = derive_channel(c.name);
		// The private-key bundle is clamped_X25519_scalar ‖ raw_seed: the
		// X25519 half is RFC 7748-clamped because microReticulum's raw
		// Montgomery ladder leaves clamping to the caller (see Channel.cpp).
		TEST_ASSERT_EQUAL_STRING(c.x25519_scalar_hex,
			channel.identity.get_private_key().left(32).toHex().c_str());
		TEST_ASSERT_EQUAL_STRING(c.pub_hex, channel.identity.get_public_key().toHex().c_str());
		TEST_ASSERT_EQUAL_STRING(c.channel_hash_hex, channel.channel_hash.toHex().c_str());
		TEST_ASSERT_EQUAL_STRING(c.channel_hash_hex, channel.identity.hash().toHex().c_str());
		// The lxmf.delivery destination hash — NOT the bare channel hash.
		TEST_ASSERT_EQUAL_STRING(
			c.delivery_hash_hex, delivery_hash_for(channel.identity).toHex().c_str());
	}
}

void testChannelDerivationIsDeterministic() {
	const Channel a = derive_channel("dacar.policy.v1");
	const Channel b = derive_channel("dacar.policy.v1");
	TEST_ASSERT_TRUE(a.channel_hash == b.channel_hash);
	TEST_ASSERT_TRUE(a.identity.get_public_key() == b.identity.get_public_key());
	TEST_ASSERT_TRUE(a.identity.get_private_key() == b.identity.get_private_key());
	TEST_ASSERT_THROW(derive_channel(""), std::invalid_argument);
}

// -- stamp contract ---------------------------------------------------------------

void testStampWorkblockMatchesCanonical() {
	for (size_t i = 0; i < DacarFixtures::RFED_STAMP_CASE_COUNT; i++) {
		const auto& c = DacarFixtures::RFED_STAMP_CASES[i];
		const StampContext context = channel_stamp_workblock(
			fromHex(c.channel_hash_hex), fromHex(c.inner_blob_hex));
		TEST_ASSERT_EQUAL_STRING(c.transient_hex, context.transient_id.toHex().c_str());
		TEST_ASSERT_EQUAL_size_t(16 * 256, context.workblock.size());
		TEST_ASSERT_EQUAL_STRING(c.workblock_hex, context.workblock.toHex().c_str());
	}
}

void testStampValuePinsLeadingZeroBits() {
	for (size_t i = 0; i < DacarFixtures::RFED_STAMP_CASE_COUNT; i++) {
		const auto& c = DacarFixtures::RFED_STAMP_CASES[i];
		const RNS::Bytes workblock = fromHex(c.workblock_hex);
		// The all-zero stamp pins the value function byte-for-byte.
		const uint8_t zeros[RFed::STAMP_SIZE] = {0};
		const RNS::Bytes zero_stamp(zeros, RFed::STAMP_SIZE);
		TEST_ASSERT_EQUAL_size_t(c.zero_stamp_value, stamp_value(workblock, zero_stamp));
		// The searched stamp's value meets the advertised cost.
		const RNS::Bytes stamp = fromHex(c.stamp_hex);
		TEST_ASSERT_EQUAL_size_t(c.stamp_value, stamp_value(workblock, stamp));
		TEST_ASSERT_TRUE(stamp_value(workblock, stamp) >= c.stamp_cost);
		TEST_ASSERT_TRUE(stamp_valid(stamp, c.stamp_cost, workblock));
		TEST_ASSERT_FALSE(stamp_valid(stamp, c.stamp_value + 1, workblock));
		// Short stamps are invalid by definition.
		TEST_ASSERT_FALSE(stamp_valid(stamp.left(8), c.stamp_cost, workblock));
	}
}

void testGenerateChannelStampProducesValidatingStamps() {
	for (size_t i = 0; i < DacarFixtures::RFED_STAMP_CASE_COUNT; i++) {
		const auto& c = DacarFixtures::RFED_STAMP_CASES[i];
		// Cost 6 for search speed in tests: expected ~64 random trials.
		const RNS::Bytes stamp = generate_channel_stamp(
			fromHex(c.channel_hash_hex), fromHex(c.inner_blob_hex), 6);
		TEST_ASSERT_EQUAL_size_t(RFed::STAMP_SIZE, stamp.size());
		TEST_ASSERT_TRUE(validate_channel_stamp(
			fromHex(c.channel_hash_hex), fromHex(c.inner_blob_hex), stamp, 6));
			// A stamp meeting cost 6 does not necessarily meet the fixture cost.
		TEST_ASSERT_FALSE(validate_channel_stamp(
			fromHex(c.channel_hash_hex), fromHex(c.inner_blob_hex), stamp.left(4), 6));
	}
}

// -- payload framing --------------------------------------------------------------

void testParseFanoutPayload() {
	const RNS::Bytes channel_hash = fromHex(DacarFixtures::RFED_CHANNEL_CASES[0].channel_hash_hex);
	const RNS::Bytes inner_blob("inner-blob-bytes");
	const RNS::Bytes payload = channel_hash + inner_blob;
	const FanoutPayload parsed = parse_fanout_payload(payload);
	TEST_ASSERT_TRUE(parsed.channel_hash == channel_hash);
	TEST_ASSERT_TRUE(parsed.inner_blob == inner_blob);
	// Too short -> throws.
	TEST_ASSERT_THROW(parse_fanout_payload(channel_hash.left(15)), std::invalid_argument);
	TEST_ASSERT_THROW(parse_fanout_payload(RNS::Bytes()), std::invalid_argument);
}

void testParseSendPayload() {
	const RNS::Bytes channel_hash = fromHex(DacarFixtures::RFED_CHANNEL_CASES[0].channel_hash_hex);
	const RNS::Bytes inner_blob("inner-blob-bytes");
	const uint8_t zeros[RFed::STAMP_SIZE] = {0};
	const RNS::Bytes stamp(zeros, RFed::STAMP_SIZE);
	const RNS::Bytes payload = channel_hash + inner_blob + stamp;
	const SendPayload parsed = parse_send_payload(payload);
	TEST_ASSERT_TRUE(parsed.channel_hash == channel_hash);
	TEST_ASSERT_TRUE(parsed.inner_blob == inner_blob);
	TEST_ASSERT_TRUE(parsed.stamp == stamp);
	// A stampless payload is too short for the SEND form.
	TEST_ASSERT_THROW(parse_send_payload(channel_hash + inner_blob), std::invalid_argument);
}

// -- RTID prelude -------------------------------------------------------------------

void testVerifyRtidPrelude() {
	const RNS::Bytes sender_pub = fromHex(DacarFixtures::RFED_COMPACT_CASES[0].sender_pub_hex);
	const RNS::Bytes tail("tail-after-prelude");
	const RNS::Bytes plaintext = RNS::Bytes("RTID") + sender_pub + tail;
	RNS::Bytes extracted_pub;
	const RNS::Bytes remainder = verify_rtid_prelude(plaintext, extracted_pub);
	TEST_ASSERT_TRUE(extracted_pub == sender_pub);
	TEST_ASSERT_TRUE(remainder == tail);
	// Wrong magic is refused.
	TEST_ASSERT_THROW(verify_rtid_prelude(RNS::Bytes("RTIX") + sender_pub + tail, extracted_pub),
		std::invalid_argument);
	// Short plaintext is refused.
	TEST_ASSERT_THROW(verify_rtid_prelude(RNS::Bytes("RTID") + sender_pub.left(63), extracted_pub),
		std::invalid_argument);
	TEST_ASSERT_THROW(verify_rtid_prelude(RNS::Bytes("RTID"), extracted_pub), std::invalid_argument);
}

// -- client helpers (pure) ------------------------------------------------------------

void testSignedChannelPayloadShape() {
	const Channel channel = derive_channel("dacar.policy.v1");
	RNS::Identity identity(false);
	identity.load_private_key(channel.identity.get_private_key());
	const RNS::Bytes payload = signed_channel_payload(identity, channel.channel_hash);
	// fixarray(3) ‖ bin8(16) ‖ bin8(64) ‖ bin8(64).
	TEST_ASSERT_EQUAL_size_t(1 + (2 + 16) + (2 + 64) + (2 + 64), payload.size());
	TEST_ASSERT_EQUAL_UINT8(0x93, payload[0]);
	TEST_ASSERT_EQUAL_UINT8(0xc4, payload[1]);
	TEST_ASSERT_EQUAL_UINT8(16, payload[2]);
	TEST_ASSERT_TRUE(payload.mid(3, 16) == channel.channel_hash);
	// The signature is verifiable: re-sign and compare against the payload's
	// third element.
	const RNS::Bytes sig = payload.mid(3 + 16 + 2 + 64 + 2, 64);
	TEST_ASSERT_TRUE(identity.validate(sig, channel.channel_hash));
}

void testDecodeSubscribeResponse() {
	// Modern node: [true, 12].
	MsgPack::Packer p;
	p.packArraySize(2);
	p.packBool(true);
	p.pack<uint32_t>(12);
	const SubscribeResult modern = decode_subscribe_response(RNS::Bytes(p.data(), p.size()));
	TEST_ASSERT_TRUE(modern.ok);
	TEST_ASSERT_TRUE(modern.has_stamp_cost);
	TEST_ASSERT_EQUAL_size_t(12, modern.stamp_cost);

	// Stamping disabled: [true, nil].
	MsgPack::Packer nil_p;
	nil_p.packArraySize(2);
	nil_p.packBool(true);
	nil_p.packNil();
	const SubscribeResult disabled = decode_subscribe_response(RNS::Bytes(nil_p.data(), nil_p.size()));
	TEST_ASSERT_TRUE(disabled.ok);
	TEST_ASSERT_FALSE(disabled.has_stamp_cost);

	// Refusal: [false, nil].
	MsgPack::Packer no_p;
	no_p.packArraySize(2);
	no_p.packBool(false);
	no_p.packNil();
	const SubscribeResult refused = decode_subscribe_response(RNS::Bytes(no_p.data(), no_p.size()));
	TEST_ASSERT_FALSE(refused.ok);

	// Legacy node: a bare boolean.
	MsgPack::Packer legacy_p;
	legacy_p.packBool(true);
	const SubscribeResult legacy = decode_subscribe_response(RNS::Bytes(legacy_p.data(), legacy_p.size()));
	TEST_ASSERT_TRUE(legacy.ok);
	TEST_ASSERT_FALSE(legacy.has_stamp_cost);

	// Garbage and empty are refusals, not crashes.
	TEST_ASSERT_FALSE(decode_subscribe_response(RNS::Bytes()).ok);
	TEST_ASSERT_FALSE(decode_subscribe_response(RNS::Bytes("garbage")).ok);
}

int runUnityTests(void) {
	UNITY_BEGIN();
	RUN_TEST(testChannelDerivationMatchesCanonical);
	RUN_TEST(testChannelDerivationIsDeterministic);
	RUN_TEST(testStampWorkblockMatchesCanonical);
	RUN_TEST(testStampValuePinsLeadingZeroBits);
	RUN_TEST(testGenerateChannelStampProducesValidatingStamps);
	RUN_TEST(testParseFanoutPayload);
	RUN_TEST(testParseSendPayload);
	RUN_TEST(testVerifyRtidPrelude);
	RUN_TEST(testSignedChannelPayloadShape);
	RUN_TEST(testDecodeSubscribeResponse);
	return UNITY_END();
}

int main(void) {
	return runUnityTests();
}

#ifdef ARDUINO
void setup() {
	delay(2000);
	runUnityTests();
}
void loop() {}
#endif

void app_main() {
	runUnityTests();
}
