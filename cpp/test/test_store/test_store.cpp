/*
 * Dacar C++ port — Store and persistence tests (§13, work doc #16 Phase 2).
 *
 * Byte-exact fixture cases (INI, clock/ledger/identities/outbox msgpack,
 * aliases text) are generated by the canonical Python Store, so the C++
 * persistence layer is validated against the reference store bytes.
 * Backend-specific tests (POSIX loose files, microStore records,
 * provisioning) run where their platform support is compiled in.
 *
 * Licensed under the EUPL-1.2 (see repository root).
 */

#include <unity.h>

#include "TestUtil.h"

#include <cstdlib>
#include <cstring>
#include <stdexcept>
#include <string>
#include <vector>

#if defined(DACAR_POSIX_STORE)
#include "Dacar/MicroStoreIo.h"
#include "Dacar/PosixStore.h"

#include <microStore/Adapters/UniversalFileSystem.h>

#include "microReticulum/Utilities/OS.h"

#include <sys/stat.h>
#include <unistd.h>
#endif

#if defined(RNS_USE_PROVISIONING)
#include "Dacar/Provisioning.h"
#endif

using namespace Dacar;
using namespace DacarTest;

void setUp(void) {}
void tearDown(void) {}

// -- §13.2 config INI -------------------------------------------------------------

static StoreConfig configFromEncodeCase(const DacarFixtures::IniEncodeCase& c) {
	StoreConfig config;
	config.primary_salt = bytesFromHex(c.primary_hex);
	config.legacy_salts = bytesVecFromHex(c.legacy_hex);
	config.anchors = bytesVecFromHex(c.anchors_hex);
	if (c.authoritative_hex && c.authoritative_hex[0]) {
		config.authoritative = bytesFromHex(c.authoritative_hex);
	}
	config.horizon_days = c.horizon_days;
	config.rfed_topic = c.rfed_topic;
	if (c.rfed_node_hex && c.rfed_node_hex[0]) {
		config.rfed_node = bytesFromHex(c.rfed_node_hex);
	}
	if (c.lxmf_proprietor_hex && c.lxmf_proprietor_hex[0]) {
		config.lxmf_proprietor = bytesFromHex(c.lxmf_proprietor_hex);
	}
	return config;
}

static RNS::Bytes bytesFromHexStr(const std::string& hex) {
	return bytesFromHex(hex.c_str());
}

static RNS::Bytes fillBytes(size_t size, uint8_t value) {
	RNS::Bytes out(size);
	memset(out.writable(size), value, size);
	return out;
}

void testIniEncodeMatchesPython() {
	for (size_t i = 0; i < DacarFixtures::INI_ENCODE_CASE_COUNT; i++) {
		const auto& c = DacarFixtures::INI_ENCODE_CASES[i];
		const std::string ini = encode_config_ini(configFromEncodeCase(c));
		const RNS::Bytes expected = bytesFromHexStr(c.expected_hex);
		const RNS::Bytes actual(ini.data(), ini.size());
		TEST_ASSERT_EQUAL_MEMORY(expected.data(), actual.data(), expected.size());
	}
}

void testIniDecodeMatchesPython() {
	for (size_t i = 0; i < DacarFixtures::INI_DECODE_CASE_COUNT; i++) {
		const auto& c = DacarFixtures::INI_DECODE_CASES[i];
		const StoreConfig config = decode_config_ini(bytesFromHexStr(c.ini_hex));
		TEST_ASSERT_TRUE(config.primary_salt == bytesFromHexStr(c.primary_hex));
		TEST_ASSERT_TRUE(config.authoritative == bytesFromHexStr(c.authoritative_hex));
		TEST_ASSERT_TRUE(config.rfed_node == bytesFromHexStr(c.rfed_node_hex));
		TEST_ASSERT_TRUE(config.lxmf_proprietor == bytesFromHexStr(c.lxmf_proprietor_hex));
		TEST_ASSERT_EQUAL_INT(c.horizon_days, config.horizon_days);
		TEST_ASSERT_EQUAL_STRING(c.rfed_topic, config.rfed_topic.c_str());
		auto legacy = bytesVecFromHex(c.legacy_hex);
		auto anchors = bytesVecFromHex(c.anchors_hex);
		TEST_ASSERT_EQUAL_size_t(legacy.size(), config.legacy_salts.size());
		for (size_t k = 0; k < legacy.size(); k++) {
			TEST_ASSERT_TRUE(legacy[k] == config.legacy_salts[k]);
		}
		TEST_ASSERT_EQUAL_size_t(anchors.size(), config.anchors.size());
		for (size_t k = 0; k < anchors.size(); k++) {
			TEST_ASSERT_TRUE(anchors[k] == config.anchors[k]);
		}
	}
}

void testIniRoundTrip() {
	for (size_t i = 0; i < DacarFixtures::INI_ENCODE_CASE_COUNT; i++) {
		const auto& c = DacarFixtures::INI_ENCODE_CASES[i];
		const StoreConfig original = configFromEncodeCase(c);
		const std::string ini = encode_config_ini(original);
		const StoreConfig decoded = decode_config_ini(RNS::Bytes(ini.data(), ini.size()));
		const std::string again = encode_config_ini(decoded);
		TEST_ASSERT_EQUAL_STRING(ini.c_str(), again.c_str());
	}
}

void testIniDecodeRejectsMalformed() {
	// Bad salt length.
	TEST_ASSERT_THROW(decode_config_ini(bytesFromHexStr(
		std::string("5b73616c745d0a7072696d617279203d2030300a")  // "[salt]\nprimary = 00\n"
	)), std::invalid_argument);
	// Bad horizon integer.
	TEST_ASSERT_THROW(decode_config_ini(bytesFromHexStr(
		std::string("5b706f6c6963795d0a64656c6574696f6e5f686f72697a6f6e5f64617973203d206162630a")  // "[policy]\ndeletion_horizon_days = abc\n"
	)), std::invalid_argument);
}

// -- §13.3 clock ---------------------------------------------------------------------

void testClockPayloadMatchesPython() {
	for (size_t i = 0; i < DacarFixtures::CLOCK_FILE_CASE_COUNT; i++) {
		const auto& c = DacarFixtures::CLOCK_FILE_CASES[i];
		const RNS::Bytes encoded = encode_clock_payload(Clock(c.last_ms, c.logical));
		const RNS::Bytes expected = bytesFromHexStr(c.expected_hex);
		TEST_ASSERT_EQUAL_MEMORY(expected.data(), encoded.data(), expected.size());
		const Clock decoded = decode_clock_payload(expected);
		TEST_ASSERT_EQUAL_UINT64(c.last_ms, decoded.last_ms());
		TEST_ASSERT_EQUAL_UINT64(c.logical, decoded.logical());
	}
}

void testClockDecodeTolerant() {
	// nil, an array, and empty input all decode to a fresh Clock.
	const Clock nilClock = decode_clock_payload(bytesFromHexStr("c0"));
	TEST_ASSERT_EQUAL_UINT64(0, nilClock.last_ms());
	TEST_ASSERT_EQUAL_UINT64(0, nilClock.logical());
	const Clock arrayClock = decode_clock_payload(bytesFromHexStr("90"));
	TEST_ASSERT_EQUAL_UINT64(0, arrayClock.last_ms());
	const Clock emptyClock = decode_clock_payload(RNS::Bytes());
	TEST_ASSERT_EQUAL_UINT64(0, emptyClock.last_ms());
}

// -- §13.6 ledger ----------------------------------------------------------------------

static void fillLedgerFromCase(const DacarFixtures::LedgerFileCase& c, Ledger& ledger) {
	for (size_t r = 0; r < c.row_count; r++) {
		const auto& row = c.rows[r];
		const RNS::Bytes tupleHash = bytesFromHexStr(row.tuple_hash_hex);
		const std::string object = row.object ? row.object : "";
		const std::string relation = row.relation ? row.relation : "";
		if (object.empty() && relation.empty() && row.wildcard < 0) {
			ledger.ensure(tupleHash);
			if (!relation.empty()) {
				ledger.annotate(tupleHash, {}, relation);
			}
		}
		else {
			ledger.record(
				tupleHash,
				object.c_str(),
				relation.c_str(),
				row.wildcard > 0,
				row.first_seen
			);
		}
	}
}

void testLedgerPayloadMatchesPython() {
	for (size_t i = 0; i < DacarFixtures::LEDGER_FILE_CASE_COUNT; i++) {
		const auto& c = *DacarFixtures::LEDGER_FILE_CASES[i];
		Ledger ledger;
		// The "recorded_and_annotated" case exercises ensure()+annotate()
		// for its second row (nil object/wildcard but a named relation),
		// mirroring how the fixture generator built the reference bytes.
		if (std::string(c.comment) == "recorded_and_annotated") {
			const auto& full = c.rows[0];
			ledger.record(
				bytesFromHexStr(full.tuple_hash_hex),
				full.object,
				full.relation,
				full.wildcard > 0,
				full.first_seen
			);
			const auto& partial = c.rows[1];
			ledger.ensure(bytesFromHexStr(partial.tuple_hash_hex));
			ledger.annotate(bytesFromHexStr(partial.tuple_hash_hex), {}, partial.relation);
		}
		else {
			fillLedgerFromCase(c, ledger);
		}
		const RNS::Bytes encoded = encode_ledger_payload(ledger);
		const RNS::Bytes expected = bytesFromHexStr(c.expected_hex);
		TEST_ASSERT_EQUAL_MEMORY(expected.data(), encoded.data(), expected.size());
		// Decoding reference bytes yields the same rows in the same order.
		const Ledger decoded = decode_ledger_payload(expected);
		TEST_ASSERT_EQUAL_size_t(ledger.rows().size(), decoded.rows().size());
		for (size_t r = 0; r < ledger.rows().size(); r++) {
			TEST_ASSERT_EQUAL_STRING(ledger.rows()[r].first.c_str(), decoded.rows()[r].first.c_str());
			const auto& a = ledger.rows()[r].second;
			const auto& b = decoded.rows()[r].second;
			TEST_ASSERT_TRUE(a.object.has_value() == b.object.has_value());
			if (a.object.has_value()) {
				TEST_ASSERT_EQUAL_STRING((*a.object).c_str(), (*b.object).c_str());
			}
			TEST_ASSERT_TRUE(a.relation.has_value() == b.relation.has_value());
			if (a.relation.has_value()) {
				TEST_ASSERT_EQUAL_STRING((*a.relation).c_str(), (*b.relation).c_str());
			}
			TEST_ASSERT_TRUE(a.wildcard.has_value() == b.wildcard.has_value());
			TEST_ASSERT_EQUAL_UINT64(a.first_seen, b.first_seen);
		}
	}
}

void testLedgerKeepsEarliestFirstSeen() {
	Ledger ledger;
	const RNS::Bytes th = bytesFromHexStr(
		"6361393738313132636131626264636166616332333162333961323364633464613738366566663831343763346537326239383037373835616665653438626282"
	);
	ledger.record(th, "engine", "start", false, 200);
	ledger.record(th, "engine", "start", false, 100);
	const LedgerRow* row = ledger.lookup(th);
	TEST_ASSERT_NOT_NULL(row);
	TEST_ASSERT_EQUAL_UINT64(100, row->first_seen);
}

// -- §13.7 identities ---------------------------------------------------------------------

void testIdentitiesPayloadMatchesPython() {
	for (size_t i = 0; i < DacarFixtures::IDENTITIES_FILE_CASE_COUNT; i++) {
		const auto& c = DacarFixtures::IDENTITIES_FILE_CASES[i];
		Keyring keyring;
		for (const auto& blob : bytesVecFromHex(c.hash_pubs_hex)) {
			RNS::Bytes hash(blob.data(), 16);
			RNS::Bytes pub(blob.data() + 16, 32);
			keyring.register_single(hash, pub);
		}
		const RNS::Bytes encoded = encode_keyring_payload(keyring);
		const RNS::Bytes expected = bytesFromHexStr(c.expected_hex);
		TEST_ASSERT_EQUAL_MEMORY(expected.data(), encoded.data(), expected.size());
		// Decoding reference bytes resolves every issuer.
		const Keyring decoded = decode_keyring_payload(expected);
		TEST_ASSERT_EQUAL_size_t(keyring.size(), decoded.size());
		for (const auto& [hash, keyset] : keyring.entries()) {
			const IssuerKeyset* resolved = decoded.resolve(hash);
			TEST_ASSERT_NOT_NULL(resolved);
			TEST_ASSERT_TRUE(resolved->member_public_keys()[0] == keyset.member_public_keys()[0]);
		}
	}
}

void testIdentitiesDecodeDropsWrongLength() {
	// A map entry whose value is 16 bytes (not 32) is dropped on load.
	const RNS::Bytes poisoned = bytesFromHexStr(
		"d920303130313031303130313031303130313031303130313031303130313031c410"
		"3031323032303230323032303230323032303230"
	);
	const Keyring keyring = decode_keyring_payload(poisoned);
	TEST_ASSERT_EQUAL_size_t(0, keyring.size());
}

void testKeyringInsertionOrder() {
	// Registration order is preserved; overwriting keeps position; forget
	// compacts without disturbing the order of the rest (Python dict parity).
	Keyring keyring;
	const RNS::Bytes a = bytesFromHexStr("01010101010101010101010101010101");
	const RNS::Bytes b = bytesFromHexStr("02020202020202020202020202020202");
	const RNS::Bytes c = bytesFromHexStr("03030303030303030303030303030303");
	const RNS::Bytes pubA = fillBytes(32, 0xA1);
	const RNS::Bytes pubB = fillBytes(32, 0xB2);
	const RNS::Bytes pubC = fillBytes(32, 0xC3);
	keyring.register_single(b, pubB);
	keyring.register_single(a, pubA);
	keyring.register_single(a, pubA); // overwrite in place
	keyring.register_single(c, pubC);
	auto entries = keyring.entries();
	TEST_ASSERT_EQUAL_size_t(3, entries.size());
	TEST_ASSERT_TRUE(entries[0].first == b);
	TEST_ASSERT_TRUE(entries[1].first == a);
	TEST_ASSERT_TRUE(entries[2].first == c);
	TEST_ASSERT_TRUE(keyring.forget(b));
	entries = keyring.entries();
	TEST_ASSERT_EQUAL_size_t(2, entries.size());
	TEST_ASSERT_TRUE(entries[0].first == a);
	TEST_ASSERT_TRUE(entries[1].first == c);
	TEST_ASSERT_NULL(keyring.resolve(b));
	TEST_ASSERT_NOT_NULL(keyring.resolve(a));
	// Re-registering a forgotten hash appends at the end.
	keyring.register_single(b, pubB);
	entries = keyring.entries();
	TEST_ASSERT_EQUAL_size_t(3, entries.size());
	TEST_ASSERT_TRUE(entries[2].first == b);
}

// -- §13.8/§13.9 payload lists -----------------------------------------------------------

void testPayloadListRoundTrip() {
	for (size_t i = 0; i < DacarFixtures::BATCH_CASE_COUNT; i++) {
		const auto& c = DacarFixtures::BATCH_CASES[i];
		const Vector<RNS::Bytes> payloads = bytesVecFromHex(c.payloads_hex);
		const RNS::Bytes encoded = encode_payload_list(payloads);
		const RNS::Bytes expected = bytesFromHexStr(c.expected_hex);
		TEST_ASSERT_EQUAL_MEMORY(expected.data(), encoded.data(), expected.size());
		const Vector<RNS::Bytes> decoded = decode_payload_list(expected);
		TEST_ASSERT_EQUAL_size_t(payloads.size(), decoded.size());
		for (size_t k = 0; k < payloads.size(); k++) {
			TEST_ASSERT_TRUE(payloads[k] == decoded[k]);
		}
	}
}

void testPayloadListCorruptionTolerated() {
	// nil and an empty map decode to empty lists (the CLI must not crash).
	TEST_ASSERT_EQUAL_size_t(0, decode_payload_list(bytesFromHexStr("c0")).size());
	TEST_ASSERT_EQUAL_size_t(0, decode_payload_list(bytesFromHexStr("80")).size());
	TEST_ASSERT_EQUAL_size_t(0, decode_payload_list(RNS::Bytes()).size());
}

// -- §13.5 aliases -------------------------------------------------------------------------

static AliasRegistry registryFromEntries(const DacarFixtures::AliasEntrySpec* entries, size_t count) {
	AliasRegistry registry;
	for (size_t i = 0; i < count; i++) {
		const auto& e = entries[i];
		const RNS::Bytes hash = bytesFromHexStr(e.hash_hex);
		for (const auto& name : splitJoined(e.names)) {
			registry.add(name.c_str(), hash);
		}
		if (e.note && e.note[0]) {
			// add() only sets the note when creating or when re-adding the
			// same name; mirror the generator's add(.., note=..) by setting
			// it on the (now existing) entry through a second add call.
			registry.add(splitJoined(e.names).front().c_str(), hash, e.note);
		}
	}
	return registry;
}

void testAliasesSerializeMatchesPython() {
	for (size_t i = 0; i < DacarFixtures::ALIASES_FILE_CASE_COUNT; i++) {
		const auto& c = *DacarFixtures::ALIASES_FILE_CASES[i];
		const AliasRegistry registry = registryFromEntries(c.entries, c.entry_count);
		const std::string text = registry.serialize();
		const RNS::Bytes expected = bytesFromHexStr(c.expected_hex);
		TEST_ASSERT_EQUAL_size_t(expected.size(), text.size());
		if (expected.size()) {
			TEST_ASSERT_EQUAL_MEMORY(expected.data(), text.data(), expected.size());
		}
	}
}

void testAliasesParseMatchesPython() {
	for (size_t i = 0; i < DacarFixtures::ALIASES_PARSE_CASE_COUNT; i++) {
		const auto& c = *DacarFixtures::ALIASES_PARSE_CASES[i];
		const RNS::Bytes textBytes = bytesFromHexStr(c.text_hex);
		const AliasRegistry reparsed = AliasRegistry::parse(
			std::string((const char*)textBytes.data(), textBytes.size())
		);
		TEST_ASSERT_EQUAL_size_t(c.entry_count, reparsed.entries.size());
		for (size_t e = 0; e < c.entry_count; e++) {
			const auto& spec = c.entries[e];
			const auto& entry = reparsed.entries[e];
			TEST_ASSERT_TRUE(entry.hash == bytesFromHexStr(spec.hash_hex));
			std::string names;
			for (const auto& n : entry.names) {
				if (!names.empty()) {
					names += " ";
				}
				names += n;
			}
			TEST_ASSERT_EQUAL_STRING(spec.names, names.c_str());
			if (spec.note && spec.note[0]) {
				TEST_ASSERT_TRUE(entry.note.has_value());
				TEST_ASSERT_EQUAL_STRING(spec.note, (*entry.note).c_str());
			}
			else {
				TEST_ASSERT_TRUE(!entry.note.has_value());
			}
		}
		// Re-serialization is byte-identical to the canonical round trip.
		const RNS::Bytes expected = bytesFromHexStr(c.reserialized_hex);
		const std::string out = reparsed.serialize();
		TEST_ASSERT_EQUAL_MEMORY(expected.data(), out.data(), expected.size());
	}
}

void testAliasRegistrySemantics() {
	AliasRegistry registry;
	const RNS::Bytes boat = bytesFromHexStr("02020202020202020202020202020202");
	const RNS::Bytes self = bytesFromHexStr("01010101010101010101010101010101");
	registry.add("boat", boat, "mmsi 2301234");
	registry.add("skipper", boat);
	TEST_ASSERT_TRUE(*registry.resolve("boat") == boat);
	TEST_ASSERT_TRUE(*registry.resolve("skipper") == boat);
	TEST_ASSERT_NULL(registry.resolve("self"));
	TEST_ASSERT_EQUAL_STRING("boat", registry.primary_name(boat)->c_str());
	// set_self re-points the self name; other names keep their binding.
	registry.add("self", boat);
	registry.set_self(self);
	TEST_ASSERT_TRUE(*registry.resolve("self") == self);
	TEST_ASSERT_TRUE(*registry.resolve("boat") == boat);
	TEST_ASSERT_TRUE(*registry.resolve("skipper") == boat);
	TEST_ASSERT_EQUAL_size_t(2, registry.entries.size());
	// remove() drops one name; the entry goes when the last name is gone.
	registry.add("node", self);
	TEST_ASSERT_TRUE(registry.remove("node"));
	TEST_ASSERT_FALSE(registry.remove("node"));
	// serialize_for_rnns strips dacar-local notes.
	registry.add("named", boat, "secret note");
	std::string rnns = registry.serialize_for_rnns();
	TEST_ASSERT_NULL(strstr(rnns.c_str(), "#"));
}

// -- POSIX backend (§13 loose files) -------------------------------------------------------

#if defined(DACAR_POSIX_STORE)

static std::string makeTempDir(const char* prefix) {
	std::string tmpl = std::string("/tmp/") + prefix + "XXXXXX";
	std::vector<char> buf(tmpl.begin(), tmpl.end());
	buf.push_back('\0');
	char* dir = ::mkdtemp(buf.data());
	return dir ? std::string(dir) : std::string();
}

static mode_t modeOf(const std::string& path) {
	struct stat st;
	if (::stat(path.c_str(), &st) != 0) {
		return (mode_t)-1;
	}
	return st.st_mode & 0777;
}

static bool fileExists(const std::string& path) {
	struct stat st;
	return ::stat(path.c_str(), &st) == 0;
}

void testPosixInitProducesReferenceLayout() {
	const std::string dir = makeTempDir("dacar-store-init-");
	TEST_ASSERT_TRUE(!dir.empty());
	PosixRecordIo io(dir.c_str());
	TEST_ASSERT_TRUE(io.ensure_directory());
	TEST_ASSERT_EQUAL_INT((mode_t)0700, modeOf(dir));

	const RNS::Bytes own = bytesFromHexStr("11111111111111111111111111111111");
	const RNS::Bytes salt = bytesFromHexStr(
		"000102030405060708090a0b0c0d0e0f101112131415161718191a1b1c1d1e1f"
	);
	TEST_ASSERT_TRUE(Store::init(io, own, salt));

	// §13.1 file set: the five eager records exist; the lazy ones do not.
	TEST_ASSERT_TRUE(fileExists(dir + "/config"));
	TEST_ASSERT_TRUE(fileExists(dir + "/clock.msgpack"));
	TEST_ASSERT_TRUE(fileExists(dir + "/state.msgpack"));
	TEST_ASSERT_TRUE(fileExists(dir + "/ledger.msgpack"));
	TEST_ASSERT_TRUE(fileExists(dir + "/aliases"));
	TEST_ASSERT_FALSE(fileExists(dir + "/identities.msgpack"));
	TEST_ASSERT_FALSE(fileExists(dir + "/outbox.msgpack"));
	TEST_ASSERT_FALSE(fileExists(dir + "/sent.msgpack"));

	// Explicit modes independent of umask (§13.1).
	TEST_ASSERT_EQUAL_INT((mode_t)0600, modeOf(dir + "/config"));
	TEST_ASSERT_EQUAL_INT((mode_t)0644, modeOf(dir + "/clock.msgpack"));
	TEST_ASSERT_EQUAL_INT((mode_t)0600, modeOf(dir + "/state.msgpack"));
	TEST_ASSERT_EQUAL_INT((mode_t)0644, modeOf(dir + "/aliases"));
	TEST_ASSERT_EQUAL_INT((mode_t)0600, modeOf(dir + "/ledger.msgpack"));

	// Canonical empty-store bytes: clock 0/0, state [], ledger {}, aliases
	// name the own identity `self`.
	RNS::Bytes data;
	TEST_ASSERT_TRUE(io.read("clock.msgpack", data));
	TEST_ASSERT_EQUAL_MEMORY("\x82\xa7last_ms\x00\xa7logical\x00", data.data(), data.size());
	TEST_ASSERT_TRUE(io.read("state.msgpack", data));
	TEST_ASSERT_EQUAL_MEMORY("\x90", data.data(), data.size());
	TEST_ASSERT_TRUE(io.read("ledger.msgpack", data));
	TEST_ASSERT_EQUAL_MEMORY("\x80", data.data(), data.size());
	TEST_ASSERT_TRUE(io.read("aliases", data));
	const std::string expectedAliases =
		"11111111111111111111111111111111 self\n";
	TEST_ASSERT_EQUAL_MEMORY(expectedAliases.data(), data.data(), data.size());

	// The config INI matches the canonical writer byte for byte.
	StoreConfig expected;
	expected.primary_salt = salt;
	expected.anchors.push_back(own);
	const std::string expectedIni = encode_config_ini(expected);
	TEST_ASSERT_TRUE(io.read("config", data));
	TEST_ASSERT_EQUAL_MEMORY(expectedIni.data(), data.data(), expectedIni.size());

	io.remove_records();
	::rmdir(dir.c_str());
}

void testPosixFullRoundTrip() {
	const std::string dir = makeTempDir("dacar-store-rt-");
	PosixRecordIo io(dir.c_str());
	TEST_ASSERT_TRUE(io.ensure_directory());
	Store store(io);
	TEST_ASSERT_FALSE(store.exists());

	const RNS::Bytes own = bytesFromHexStr("12121212121212121212121212121212");
	TEST_ASSERT_TRUE(Store::init(io, own));
	TEST_ASSERT_TRUE(store.exists());

	// Config: load, mutate, save, reload.
	StoreConfig config;
	TEST_ASSERT_TRUE(store.load_config_raw(config));
	TEST_ASSERT_EQUAL_size_t(1, config.anchors.size());
	config.legacy_salts.push_back(bytesFromHexStr(
		"1f1e1d1c1b1a191817161514131211100f0e0d0c0b0a09080706050403020100"
	));
	config.authoritative = bytesFromHexStr("33333333333333333333333333333333");
	TEST_ASSERT_TRUE(store.save_config(config));
	StoreConfig reloaded;
	TEST_ASSERT_TRUE(store.load_config_raw(reloaded));
	TEST_ASSERT_EQUAL_size_t(1, reloaded.legacy_salts.size());
	TEST_ASSERT_TRUE(reloaded.authoritative == config.authoritative);

	// Validated config loads and carries the anchor.
	const Config validated = store.load_config();
	TEST_ASSERT_TRUE(validated.is_root_anchor(own));
	TEST_ASSERT_EQUAL_INT(1, reloaded.legacy_salts.size());

	// Clock round-trip: HLC persistence (reboot must never rewind it).
	Clock clock = store.load_clock();
	const uint64_t stamp = clock.now();
	TEST_ASSERT_TRUE(store.save_clock(clock));
	Clock restored = store.load_clock();
	TEST_ASSERT_EQUAL_UINT64(stamp >> 16, restored.last_ms());
	TEST_ASSERT_TRUE(restored.now() > stamp);

	// State round-trip against a §13.4 snapshot fixture.
	const auto& snapshot = *DacarFixtures::STATE_CASES[0];
	auto hashers = hashersFor(snapshot.salt_hex, snapshot.legacy_hex);
	StateVector state(snapshot.horizon_days);
	for (size_t s = 0; s < snapshot.step_count; s++) {
		applyStep(state, snapshot.steps[s], hashers);
	}
	TEST_ASSERT_TRUE(store.save_state(state));
	RNS::Bytes onDisk;
	TEST_ASSERT_TRUE(io.read("state.msgpack", onDisk));
	const RNS::Bytes expected = bytesFromHexStr(snapshot.expected_hex);
	TEST_ASSERT_EQUAL_MEMORY(expected.data(), onDisk.data(), onDisk.size());
	const StateVector loaded = store.load_state(snapshot.horizon_days);
	TEST_ASSERT_EQUAL_size_t(state.size(), loaded.size());
	TEST_ASSERT_EQUAL_MEMORY(
		state.to_payload().data(), loaded.to_payload().data(), state.to_payload().size()
	);

	// Ledger round-trip.
	Ledger ledger;
	ledger.record(
		bytesFromHexStr(
			"63613937383131326361316262646361666163323331623339613233646334646137383665666638313437633465373262393830373738356166656534386262"
		),
		"vessel:2301234:buzzer", "sound", true, 0x0000ABCD1234
	);
	TEST_ASSERT_TRUE(store.save_ledger(ledger));
	const Ledger loadedLedger = store.load_ledger();
	TEST_ASSERT_EQUAL_size_t(1, loadedLedger.size());

	// Keyring round-trip + verify keyring composition.
	Keyring keyring;
	keyring.register_single(
		bytesFromHexStr("44444444444444444444444444444444"),
		fillBytes(32, 0x44)
	);
	TEST_ASSERT_TRUE(store.save_keyring(keyring));
	const Keyring loadedKeyring = store.load_keyring();
	TEST_ASSERT_EQUAL_size_t(1, loadedKeyring.size());
	const RNS::Bytes ownPub = fillBytes(32, 0x12);
	const Keyring verify = store.keyring_for_verify(own, ownPub);
	TEST_ASSERT_EQUAL_size_t(2, verify.size());
	TEST_ASSERT_NOT_NULL(verify.resolve(own));

	// Outbox / sent round-trips with §5.3 payload bytes.
	const Vector<RNS::Bytes> payloads = bytesVecFromHex(DacarFixtures::BATCH_CASES[0].payloads_hex);
	TEST_ASSERT_TRUE(store.save_outbox(payloads));
	const Vector<RNS::Bytes> outbox = store.load_outbox();
	TEST_ASSERT_EQUAL_size_t(payloads.size(), outbox.size());
	TEST_ASSERT_TRUE(payloads[0] == outbox[0]);
	TEST_ASSERT_TRUE(store.save_sent(payloads));
	const Vector<RNS::Bytes> sent = store.load_sent();
	TEST_ASSERT_EQUAL_size_t(payloads.size(), sent.size());
	TEST_ASSERT_TRUE(payloads[1] == sent[1]);

	// Aliases round-trip through the POSIX backend.
	AliasRegistry aliases;
	aliases.add("boat", bytesFromHexStr("55555555555555555555555555555555"), "the ferry");
	TEST_ASSERT_TRUE(store.save_aliases(aliases));
	const AliasRegistry loadedAliases = store.load_aliases();
	TEST_ASSERT_NOT_NULL(loadedAliases.resolve("boat"));

	io.remove_records();
	::rmdir(dir.c_str());
}

void testPosixIdentityRecord() {
	const std::string dir = makeTempDir("dacar-store-id-");
	PosixRecordIo io(dir.c_str());
	TEST_ASSERT_TRUE(io.ensure_directory());

	// RNS::Identity persists through RNS::OS, which needs a registered
	// filesystem (native builds use the microStore POSIX adapter).
	microStore::Adapters::UniversalFileSystem fs("/");
	RNS::Utilities::OS::register_filesystem(fs);

	RNS::Identity identity(true);
	TEST_ASSERT_TRUE(Store::save_identity(io.path_for(IDENTITY_RECORD), identity));
	TEST_ASSERT_EQUAL_INT((mode_t)0600, modeOf(dir + "/identity"));

	RNS::Identity loaded;
	TEST_ASSERT_TRUE(Store::load_identity(io.path_for(IDENTITY_RECORD), loaded));
	TEST_ASSERT_TRUE(loaded.hash() == identity.hash());

	RNS::Utilities::OS::deregister_filesystem();
	io.remove_records();
	::rmdir(dir.c_str());
}

// -- microStore backend (MCU records) --------------------------------------------------

void testMicroStoreBackendRoundTrip() {
	const std::string base = makeTempDir("dacar-ustore-");
	TEST_ASSERT_TRUE(!base.empty());
	microStore::Adapters::UniversalFileSystem fs(base.c_str());
	MicroStoreRecordIo::BlobStore blobStore(8192, 2);
	TEST_ASSERT_TRUE(blobStore.init(fs, "dacar"));
	MicroStoreRecordIo io(blobStore);

	const RNS::Bytes own = bytesFromHexStr("66666666666666666666666666666666");
	const RNS::Bytes salt = bytesFromHexStr(
		"0a0a0a0a0a0a0a0a0a0a0a0a0a0a0a0a0a0a0a0a0a0a0a0a0a0a0a0a0a0a0a0a"
	);
	TEST_ASSERT_TRUE(Store::init(io, own, salt));
	Store store(io);
	TEST_ASSERT_TRUE(store.exists());

	// Records land in the FileStore and load back intact.
	StoreConfig config;
	TEST_ASSERT_TRUE(store.load_config_raw(config));
	TEST_ASSERT_TRUE(config.primary_salt == salt);
	TEST_ASSERT_EQUAL_size_t(1, config.anchors.size());
	TEST_ASSERT_TRUE(config.anchors[0] == own);

	// Record bytes are identical to the §13 loose-file layout: compare
	// against a POSIX store initialized with the same arguments.
	const std::string refDir = makeTempDir("dacar-ustore-ref-");
	PosixRecordIo refIo(refDir.c_str());
	TEST_ASSERT_TRUE(refIo.ensure_directory());
	TEST_ASSERT_TRUE(Store::init(refIo, own, salt));
	static const char* records[] = {
		CONFIG_RECORD, CLOCK_RECORD, STATE_RECORD, ALIASES_RECORD, LEDGER_RECORD,
	};
	for (const char* record : records) {
		RNS::Bytes viaFileStore;
		RNS::Bytes viaLooseFiles;
		TEST_ASSERT_TRUE(io.read(record, viaFileStore));
		TEST_ASSERT_TRUE(refIo.read(record, viaLooseFiles));
		TEST_ASSERT_EQUAL_MEMORY(
			viaLooseFiles.data(), viaFileStore.data(), viaLooseFiles.size()
		);
	}

	// Mutations round-trip through the KV backend as well.
	Vector<RNS::Bytes> payloads = bytesVecFromHex(DacarFixtures::BATCH_CASES[0].payloads_hex);
	TEST_ASSERT_TRUE(store.save_outbox(payloads));
	const Vector<RNS::Bytes> outbox = store.load_outbox();
	TEST_ASSERT_EQUAL_size_t(payloads.size(), outbox.size());

	refIo.remove_records();
	::rmdir(refDir.c_str());
	// Best-effort cleanup of the segment files written under base/dacar.
	::system(("rm -rf '" + base + "'").c_str());
}

#endif // DACAR_POSIX_STORE

// -- provisioning namespace (MCU config surface) --------------------------------------

#if defined(RNS_USE_PROVISIONING)

void testProvisioningNamespaceBindsConfig() {
	RNS::Provisioning::Provisioner& p = RNS::Provisioning::Provisioner::instance();

#if defined(RNS_USE_FS) && defined(DACAR_POSIX_STORE)
	// Full boot cycle against the real provisioning storage: commit a
	// reboot-required salt, "reboot" (end + begin), and observe the persisted
	// value reach a freshly bound StoreConfig through the boot setters.
	const std::string root = makeTempDir("dacar-prov-");
	TEST_ASSERT_TRUE(!root.empty());
	microStore::Adapters::UniversalFileSystem fs(root.c_str());
	RNS::Utilities::OS::register_filesystem(fs);
	{
		StoreConfig config;
		config.primary_salt = bytesFromHexStr(
			"000102030405060708090a0b0c0d0e0f101112131415161718191a1b1c1d1e1f"
		);
		config.anchors.push_back(bytesFromHexStr("77777777777777777777777777777777"));
		Dacar::Provisioning::register_dacar_namespace(p, config);
		// Idempotent re-registration.
		Dacar::Provisioning::register_dacar_namespace(p, config);
		p.begin(root.c_str());

		// The live getter reflects the bound StoreConfig.
		RNS::Provisioning::Value salt = p.field(
			Dacar::Provisioning::DacarConfig::Id,
			Dacar::Provisioning::DacarConfig::Field::PrimarySalt
		);
		TEST_ASSERT_TRUE(salt.as_bytes() == config.primary_salt);

		// A reboot-required commit persists but takes effect at boot: the
		// bound config is not mutated yet (§10 rotation semantics).
		RNS::Bytes replacement = bytesFromHexStr(
			"1f1e1d1c1b1a191817161514131211100f0e0d0c0b0a09080706050403020100"
		);
		TEST_ASSERT_TRUE(p.field(
			Dacar::Provisioning::DacarConfig::Id,
			Dacar::Provisioning::DacarConfig::Field::PrimarySalt,
			RNS::Provisioning::Value(replacement)
		));
		TEST_ASSERT_TRUE(p.commit(Dacar::Provisioning::DacarConfig::Id));
		TEST_ASSERT_TRUE(config.primary_salt != replacement);

		// Reboot: everything drops, a fresh namespace binding loads the
		// persisted salt through the boot-time setters.
		p.end();
		StoreConfig booted;
		booted.primary_salt = bytesFromHexStr(
			"000102030405060708090a0b0c0d0e0f101112131415161718191a1b1c1d1e1f"
		);
		Dacar::Provisioning::register_dacar_namespace(p, booted);
		p.begin(root.c_str());
		TEST_ASSERT_TRUE(booted.primary_salt == replacement);
		p.end();
	}
	RNS::Utilities::OS::deregister_filesystem();
	::rmdir(root.c_str());
#endif // RNS_USE_FS && DACAR_POSIX_STORE

	// Live-apply fields mutate the bound StoreConfig on commit, and
	// constraint validation rejects out-of-bounds drafts.
	{
		StoreConfig config;
		config.horizon_days = 180;
		Dacar::Provisioning::register_dacar_namespace(p, config);

		TEST_ASSERT_TRUE(p.field(
			Dacar::Provisioning::DacarConfig::Id,
			Dacar::Provisioning::DacarConfig::Field::DeletionHorizonDays,
			RNS::Provisioning::Value((int64_t)90)
		));
		TEST_ASSERT_TRUE(p.commit(Dacar::Provisioning::DacarConfig::Id));
		TEST_ASSERT_EQUAL_INT(90, config.horizon_days);

		// Out-of-bounds draft (min 1) is rejected at draft time: nothing is
		// committed and the bound config is unchanged.
		TEST_ASSERT_FALSE(p.field(
			Dacar::Provisioning::DacarConfig::Id,
			Dacar::Provisioning::DacarConfig::Field::DeletionHorizonDays,
			RNS::Provisioning::Value((int64_t)0)
		));
		TEST_ASSERT_TRUE(p.commit(Dacar::Provisioning::DacarConfig::Id));
		TEST_ASSERT_EQUAL_INT(90, config.horizon_days);

		// Anchors list round-trips through the setter.
		RNS::Provisioning::fbytes_list_t anchors;
		anchors.push_back(bytesFromHexStr("77777777777777777777777777777777"));
		anchors.push_back(bytesFromHexStr("88888888888888888888888888888888"));
		TEST_ASSERT_TRUE(p.field(
			Dacar::Provisioning::DacarConfig::Id,
			Dacar::Provisioning::DacarConfig::Field::Anchors,
			RNS::Provisioning::Value(anchors)
		));
		TEST_ASSERT_TRUE(p.commit(Dacar::Provisioning::DacarConfig::Id));
		TEST_ASSERT_EQUAL_size_t(2, config.anchors.size());

		p.end();
	}
}

#endif // RNS_USE_PROVISIONING

int runUnityTests(void) {
	UNITY_BEGIN();
	RUN_TEST(testIniEncodeMatchesPython);
	RUN_TEST(testIniDecodeMatchesPython);
	RUN_TEST(testIniRoundTrip);
	RUN_TEST(testIniDecodeRejectsMalformed);
	RUN_TEST(testClockPayloadMatchesPython);
	RUN_TEST(testClockDecodeTolerant);
	RUN_TEST(testLedgerPayloadMatchesPython);
	RUN_TEST(testLedgerKeepsEarliestFirstSeen);
	RUN_TEST(testIdentitiesPayloadMatchesPython);
	RUN_TEST(testIdentitiesDecodeDropsWrongLength);
	RUN_TEST(testKeyringInsertionOrder);
	RUN_TEST(testPayloadListRoundTrip);
	RUN_TEST(testPayloadListCorruptionTolerated);
	RUN_TEST(testAliasesSerializeMatchesPython);
	RUN_TEST(testAliasesParseMatchesPython);
	RUN_TEST(testAliasRegistrySemantics);
#if defined(DACAR_POSIX_STORE)
	RUN_TEST(testPosixInitProducesReferenceLayout);
	RUN_TEST(testPosixFullRoundTrip);
	RUN_TEST(testPosixIdentityRecord);
	RUN_TEST(testMicroStoreBackendRoundTrip);
#endif
#if defined(RNS_USE_PROVISIONING)
	RUN_TEST(testProvisioningNamespaceBindsConfig);
#endif
	return UNITY_END();
}

int main(void) {
	return runUnityTests();
}

#ifdef ARDUINO
void setup() {
	delay(2000);
	runUnityTests();
}
void loop() {}
#endif

void app_main() {
	runUnityTests();
}
